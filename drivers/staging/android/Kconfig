## drivers/staging/android/Kconfig
```kconfig
menu "Android"

if ANDROID

config ASHMEM
	bool "Enable the Anonymous Shared Memory Subsystem"
	default n
	depends on SHMEM
	---help---
	  The ashmem subsystem is a new shared memory allocator, similar to
	  POSIX SHM but with different behavior and sporting a simpler
	  file-based API.

	  It is, in theory, a good memory allocator for low-memory devices,
	  because it can discard shared memory units when under memory pressure.

config ANDROID_LOW_MEMORY_KILLER
	bool "Android Low Memory Killer"
	---help---
	  Registers processes to be killed when low memory conditions, this is useful
	  as there is no particular swap space on android.

	  The registered process will kill according to the priorities in android init
	  scripts (/init.rc), and it defines priority values with minimum free memory size
	  for each priority.

config ANDROID_LOW_MEMORY_KILLER_TNG
	bool "Android Low Memory Killer TNG"
	depends on ANDROID_LOW_MEMORY_KILLER
	select OOM_SCORE_NOTIFIER
	---help---
	  The NEXT generation (TNG) lowmemorykiller.
	  Registers processes to be killed when low memory conditions, this is useful
	  as there is no particular swap space on android.

	  The registered process will kills according to the priorities in android init
	  scripts (/init.rc), and it defines priority values with minimum free memory size
	  for each priority.

config ANDROID_LOW_MEMORY_KILLER_STATS
	bool "Android Low Memory Killer: collect statistics"
	depends on ANDROID_LOW_MEMORY_KILLER_TNG
	default n
	help
	  Create a file in /proc/lmkstats that includes
	  collected statistics about kills, scans and counts
	  and  interaction with the shrinker. Its content
	  will be different depending on lmk implementation used
	  in TNG lowmemorykiller.

config ANDROID_LOW_MEMORY_KILLER_AUTODETECT_OOM_ADJ_VALUES
	bool "Android Low Memory Killer: detect oom_adj values"
	depends on ANDROID_LOW_MEMORY_KILLER
	default y
	---help---
	  Detect oom_adj values written to
	  /sys/module/lowmemorykiller/parameters/adj and convert them
	  to oom_score_adj values.

config ANDROID_INTF_ALARM_DEV
	tristate "Android alarm driver"
	depends on RTC_CLASS
	default n
	---help---
	  Provides non-wakeup and rtc backed wakeup alarms based on rtc or
	  elapsed realtime, and a non-wakeup alarm on the monotonic clock.
	  Also exports the alarm interface to user-space.

config ANDROID_LMK_ADJ_RBTREE
	bool "Use RBTREE for Android Low Memory Killer"
	depends on ANDROID_LOW_MEMORY_KILLER
	default y
	---help---
	  Use oom_score_adj rbtree to select the best proecss to kill
	  when system in low memory status.

config ANDROID_BG_SCAN_MEM
	bool "SCAN free memory more frequently"
	depends on ANDROID_LOW_MEMORY_KILLER && ANDROID_LMK_ADJ_RBTREE && CGROUP_SCHED
	default N
	---help---
	  Add more free-memory check point. Such as, when a task is moved to
	  background task groups, we can trigger low memory killer to scan
	  memory and decide whether it needs to reclaim memory by killing tasks.

config ANDROID_VSOC
	tristate "Android Virtual SoC support"
	default n
	depends on PCI_MSI
	---help---
	  This option adds support for the Virtual SoC driver needed to boot
	  a 'cuttlefish' Android image inside QEmu. The driver interacts with
	  a QEmu ivshmem device. If built as a module, it will be called vsoc.

config SAMSUNG_FREECESS
	bool "thraw frozen process when recv sig"
	default n
	help
	  thraw frozen process when recv sig.

source "drivers/staging/android/ion/Kconfig"
source "drivers/staging/android/switch/Kconfig"

endif # if ANDROID

endmenu
```
